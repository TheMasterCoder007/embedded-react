## examples/esp32/esp32-s3/main/Kconfig.projbuild
```kconfig
menu "embedded-react: WiFi"

    config ER_WIFI
        bool "WiFi: a network menu for the app, and the clock over SNTP"
        default n
        help
            Runs a WiFi station the app can scan with and point at a network (the thermostat's settings
            sheet does), saves the network and the time zone in NVS, and keeps the app's Date.now() on an
            NTP server (main/network.c). Off by default: WiFi takes internal RAM this board has little of
            (see the README's "WiFi" section).

    config ER_SNTP_SERVER
        string "NTP server"
        depends on ER_WIFI
        default "pool.ntp.org"

endmenu

menu "embedded-react: Flow B"

    config ER_FLOW_B
        bool "Flow B: load a compiled package from a slot, with no QuickJS"
        default n
        help
            Builds main_flow_b.c in place of the Flow A host: the firmware reserves an arena and loads the
            active package from the erb_a and erb_b partitions (see sdkconfig.defaults.flow-b).

endmenu
```
